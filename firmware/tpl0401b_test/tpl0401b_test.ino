// TPL0401B Digital Potentiometer I2C Test
// Target: Raspberry Pi Pico (RP2040) via Earle Philhower arduino-pico core
//
// Wiring (matches main firmware pin assignments):
//   SDA -> GPIO 16
//   SCL -> GPIO 17
//   VCC -> 3.3V
//   GND -> GND
//
// Serial commands (115200 baud):
//   SCAN              - scan I2C bus and report found devices
//   READ              - read current wiper position from TPL0401B
//   SET <0-127>       - set wiper to position (0=min resistance, 127=max)
//   SWEEP             - sweep wiper 0->127->0, printing each position readback
//   HELP              - print command list
//
// GENERATED BY CLAUDE CODE - VIBED BY DANIELKM-EE

#include <Wire.h>

// --- Pin and device config (matches firmware.ino) ---
static const uint8_t SDA_PIN   = 16;
static const uint8_t SCL_PIN   = 17;
static const uint8_t DPOT_ADDR = 0x3E;   // TPL0401B 7-bit address
static const uint32_t I2C_FREQ = 10000;  // 10 kHz, matches firmware

// TPL0401B has a single 8-bit register; the lower 7 bits set wiper position (0-127).
static const uint8_t DPOT_MAX_POS = 127;

// Milliseconds between steps during a sweep
static const uint16_t SWEEP_STEP_DELAY_MS = 20;

// -------------------------------------------------------
// Low-level helpers
// -------------------------------------------------------

// Returns true if an I2C device ACKs at addr.
static bool i2c_device_present(uint8_t addr) {
    Wire.beginTransmission(addr);
    return Wire.endTransmission() == 0;
}

// Write wiper position (0-127) to the TPL0401B.
// Returns true on success (device ACK'd).
static bool dpot_write(uint8_t position) {
    if (position > DPOT_MAX_POS) position = DPOT_MAX_POS;
    Wire.beginTransmission(DPOT_ADDR);
    Wire.write(position);
    return Wire.endTransmission() == 0;
}

// Read back the current wiper position register.
// Returns -1 on failure.
static int dpot_read() {
    if (Wire.requestFrom((uint8_t)DPOT_ADDR, (uint8_t)1) != 1) return -1;
    return Wire.read();
}

// -------------------------------------------------------
// Test routines
// -------------------------------------------------------

static void cmd_scan() {
    Serial.println("Scanning I2C bus (0x08 - 0x77)...");
    uint8_t found = 0;
    for (uint8_t addr = 0x08; addr <= 0x77; addr++) {
        if (i2c_device_present(addr)) {
            Serial.print("  Found device at 0x");
            if (addr < 0x10) Serial.print("0");
            Serial.print(addr, HEX);
            if (addr == DPOT_ADDR) Serial.print("  <-- TPL0401B");
            Serial.println();
            found++;
        }
    }
    if (found == 0) {
        Serial.println("  No devices found. Check wiring and pull-up resistors.");
    } else {
        Serial.print("  Total: ");
        Serial.print(found);
        Serial.println(" device(s)");
    }
}

static void cmd_read() {
    if (!i2c_device_present(DPOT_ADDR)) {
        Serial.println("ERROR: No ACK from TPL0401B (0x3E). Check wiring.");
        return;
    }
    int val = dpot_read();
    if (val < 0) {
        Serial.println("ERROR: Read failed (no data byte returned).");
        return;
    }
    Serial.print("Wiper position: ");
    Serial.println(val);
}

static void cmd_set(uint8_t position) {
    if (position > DPOT_MAX_POS) {
        Serial.print("ERROR: Position ");
        Serial.print(position);
        Serial.print(" exceeds maximum (");
        Serial.print(DPOT_MAX_POS);
        Serial.println(").");
        return;
    }
    if (!dpot_write(position)) {
        Serial.println("ERROR: No ACK from TPL0401B during write. Check wiring.");
        return;
    }
    // Readback to confirm
    delay(2);
    int readback = dpot_read();
    if (readback < 0) {
        Serial.println("ERROR: Write sent but readback failed.");
        return;
    }
    if ((uint8_t)readback != position) {
        Serial.print("MISMATCH: wrote ");
        Serial.print(position);
        Serial.print(", read back ");
        Serial.println(readback);
        return;
    }
    Serial.print("OK: wiper set to ");
    Serial.println(position);
}

static void cmd_sweep() {
    if (!i2c_device_present(DPOT_ADDR)) {
        Serial.println("ERROR: No ACK from TPL0401B. Aborting sweep.");
        return;
    }
    Serial.println("Sweeping 0 -> 127 -> 0. Press any key to abort.");

    // Ramp up
    for (int pos = 0; pos <= DPOT_MAX_POS; pos++) {
        if (Serial.available()) { Serial.println("Aborted."); return; }
        if (!dpot_write((uint8_t)pos)) {
            Serial.print("ERROR: Write failed at position ");
            Serial.println(pos);
            return;
        }
        delay(2);
        int rb = dpot_read();
        Serial.print("  pos ");
        if (pos < 100) Serial.print(" ");
        if (pos < 10)  Serial.print(" ");
        Serial.print(pos);
        Serial.print(" -> readback: ");
        if (rb < 0) {
            Serial.println("READ FAIL");
        } else if ((uint8_t)rb != (uint8_t)pos) {
            Serial.print(rb);
            Serial.println(" MISMATCH");
        } else {
            Serial.println("OK");
        }
        delay(SWEEP_STEP_DELAY_MS);
    }

    // Ramp down
    for (int pos = DPOT_MAX_POS; pos >= 0; pos--) {
        if (Serial.available()) { Serial.println("Aborted."); return; }
        if (!dpot_write((uint8_t)pos)) {
            Serial.print("ERROR: Write failed at position ");
            Serial.println(pos);
            return;
        }
        delay(2);
        int rb = dpot_read();
        Serial.print("  pos ");
        if (pos < 100) Serial.print(" ");
        if (pos < 10)  Serial.print(" ");
        Serial.print(pos);
        Serial.print(" -> readback: ");
        if (rb < 0) {
            Serial.println("READ FAIL");
        } else if ((uint8_t)rb != (uint8_t)pos) {
            Serial.print(rb);
            Serial.println(" MISMATCH");
        } else {
            Serial.println("OK");
        }
        delay(SWEEP_STEP_DELAY_MS);
    }

    Serial.println("Sweep complete.");
}

static void print_help() {
    Serial.println("Commands:");
    Serial.println("  SCAN          - scan I2C bus for devices");
    Serial.println("  READ          - read current wiper position");
    Serial.println("  SET <0-127>   - set wiper position and verify readback");
    Serial.println("  SWEEP         - sweep full range and verify each step");
    Serial.println("  HELP          - print this message");
}

// -------------------------------------------------------
// Command parser
// -------------------------------------------------------

static void process_command(String cmd) {
    cmd.trim();

    if (cmd.equalsIgnoreCase("SCAN")) {
        cmd_scan();
    } else if (cmd.equalsIgnoreCase("READ")) {
        cmd_read();
    } else if (cmd.equalsIgnoreCase("SWEEP")) {
        cmd_sweep();
    } else if (cmd.equalsIgnoreCase("HELP")) {
        print_help();
    } else if (cmd.startsWith("SET ") || cmd.startsWith("set ")) {
        String arg = cmd.substring(4);
        arg.trim();
        long val = arg.toInt();
        if (val < 0 || val > 255 || (arg.length() == 0)) {
            Serial.println("ERROR: SET requires an integer argument (0-127).");
        } else {
            cmd_set((uint8_t)val);
        }
    } else if (cmd.length() > 0) {
        Serial.print("Unknown command: \"");
        Serial.print(cmd);
        Serial.println("\". Type HELP for a list of commands.");
    }
}

// -------------------------------------------------------
// Arduino entry points
// -------------------------------------------------------

void setup() {
    Serial.begin(115200);
    while (!Serial && millis() < 3000);  // wait up to 3s for USB serial

    Serial.println("=== TPL0401B I2C Test ===");
    Serial.print("SDA: GPIO "); Serial.print(SDA_PIN);
    Serial.print("  SCL: GPIO "); Serial.print(SCL_PIN);
    Serial.print("  DPOT addr: 0x"); Serial.println(DPOT_ADDR, HEX);
    Serial.println();

    Wire.setSDA(SDA_PIN);
    Wire.setSCL(SCL_PIN);
    Wire.begin();
    Wire.setClock(I2C_FREQ);

    // Initial presence check
    if (i2c_device_present(DPOT_ADDR)) {
        Serial.println("TPL0401B found on bus.");
    } else {
        Serial.println("WARNING: No ACK from TPL0401B (0x3E). Check wiring.");
    }
    Serial.println();
    print_help();
    Serial.println();
}

void loop() {
    if (Serial.available()) {
        String cmd = Serial.readStringUntil('\n');
        process_command(cmd);
    }
}
